## config/west.yml
```yaml
# manifest:
#   remotes:
#     - name: amkarkhi
#       url-base: https://github.com/amkarkhi
#   projects:
#     - name: zmk
#       remote: amkarkhi
#       revision: main
#       import: app/west.yml
#   self:
#     path: config
manifest:
  remotes:
    - name: zmkfirmware
      url-base: https://github.com/zmkfirmware
  projects:
    - name: zmk
      remote: zmkfirmware
      revision: main
      import: app/west.yml
  self:
    path: config
```
